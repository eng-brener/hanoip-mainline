// SPDX-License-Identifier: BSD-3-Clause
#include "sm7150-motorola-hanoip.dts"

/* This DTB is also handed to Linux. Keep internal storage unavailable. */
&ufs_mem_hc {
	status = "disabled";
};

&ufs_mem_phy {
	status = "disabled";
};

&ice {
	status = "disabled";
};
