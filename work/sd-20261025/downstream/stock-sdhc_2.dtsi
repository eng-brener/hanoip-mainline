		sdhc_2: sdhci@8804000 {
			compatible = "qcom,sdhci-msm-v5";
			reg = <0x8804000 0x1000>;
			reg-names = "hc_mem";
			interrupts = <0x00 0xcc 0x00 0x00 0xde 0x00>;
			interrupt-names = "hc_irq", "pwr_irq";
			qcom,bus-width = <0x04>;
			qcom,large-address-bus;
			qcom,clk-rates = <0x61a80 0x1312d00 0x17d7840 0x2faf080 0x5f5e100 0xc0a4680>;
			qcom,bus-speed-mode = "SDR12", "SDR25", "SDR50", "DDR50", "SDR104";
			qcom,devfreq,freq-table = <0x2faf080 0xc0a4680>;
			qcom,msm-bus,name = "sdhc2";
			qcom,msm-bus,num-cases = <0x08>;
			qcom,msm-bus,num-paths = <0x02>;
			qcom,msm-bus,vectors-KBps = <0x51 0x200 0x00 0x00 0x01 0x260 0x00 0x00 0x51 0x200 0x3e8 0x7d0 0x01 0x260 0x640 0x4e20 0x51 0x200 0x4e20 0x9c40 0x01 0x260 0x4e20 0x9c40 0x51 0x200 0x9c40 0x13880 0x01 0x260 0x7530 0xea60 0x51 0x200 0xea60 0x1d4c0 0x01 0x260 0x9c40 0x13880 0x51 0x200 0x13880 0x27100 0x01 0x260 0xc350 0x186a0 0x51 0x200 0x186a0 0x30d40 0x01 0x260 0xea60 0x1d4c0 0x51 0x200 0x146cc2 0x3e8000 0x01 0x260 0x146cc2 0x3e8000>;
			qcom,bus-bw-vectors-bps = <0x00 0x61a80 0x1312d00 0x17d7840 0x2faf080 0x60152b0 0xbebc200 0xffffffff>;
			qcom,pm-qos-irq-type = "affine_irq";
			qcom,pm-qos-irq-latency = <0x43 0x43>;
			qcom,pm-qos-cpu-groups = <0x3f 0xc0>;
			qcom,pm-qos-legacy-latency-us = <0x43 0x43 0x43 0x43>;
			clocks = <0x27 0x70 0x27 0x71>;
			clock-names = "iface_clk", "core_clk";
			qcom,dll-hsr-list = <0x7642c 0x00 0x00 0x10800 0x80040868>;
			status = "ok";
			phandle = <0x253>;
			vdd-supply = <0x374>;
			qcom,vdd-voltage-level = <0x2d0370 0x2d0370>;
			qcom,vdd-current-level = <0x00 0xc3500>;
			vdd-io-supply = <0x371>;
			qcom,vdd-io-voltage-level = <0x1b7740 0x2d0370>;
			qcom,vdd-io-current-level = <0x00 0x55f0>;
			pinctrl-names = "active", "sleep";
			pinctrl-0 = <0x353 0x355 0x357 0x359>;
			pinctrl-1 = <0x354 0x356 0x358 0x35a>;
			cd-gpios = <0x31 0x45 0x00>;
		};
