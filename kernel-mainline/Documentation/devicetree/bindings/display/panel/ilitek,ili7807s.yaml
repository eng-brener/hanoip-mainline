## kernel-mainline/Documentation/devicetree/bindings/display/panel/ilitek,ili7807s.yaml
```yaml
# SPDX-License-Identifier: (GPL-2.0-only OR BSD-2-Clause)
%YAML 1.2
---
$id: http://devicetree.org/schemas/display/panel/ilitek,ili7807s.yaml#
$schema: http://devicetree.org/meta-schemas/core.yaml#

title: Ilitek ILI7807S-based DSI panel

maintainers:
  - Arpit Saini <asaini@codeaurora.org>

allOf:
  - $ref: panel-common.yaml#

properties:
  compatible:
    enum:
      - dlc,dlc0697
      - tianma,ili7807s-hanoip

  reg:
    maxItems: 1

  vddi-supply: true
  avdd-supply: true
  avee-supply: true

required:
  - compatible
  - reg
  - vddi-supply
  - avdd-supply
  - avee-supply
  - reset-gpios

unevaluatedProperties: false

examples:
  - |
    #include <dt-bindings/gpio/gpio.h>

    dsi {
      #address-cells = <1>;
      #size-cells = <0>;

      panel@0 {
        compatible = "tianma,ili7807s-hanoip";
        reg = <0>;

        vddi-supply = <&vreg_l13a_1p8>;
        avdd-supply = <&vreg_lab>;
        avee-supply = <&vreg_ibb>;

        reset-gpios = <&pm6150l_gpios 9 GPIO_ACTIVE_LOW>;

        port {
          panel_in: endpoint {
            remote-endpoint = <&dsi0_out>;
          };
        };
      };
    };
...
```

## kernel-mainline/Documentation/devicetree/bindings/regulator/qcom,pm6150l-lcdb.yaml
```yaml
# SPDX-License-Identifier: GPL-2.0-only OR BSD-2-Clause
%YAML 1.2
---
$id: http://devicetree.org/schemas/regulator/qcom,pm6150l-lcdb.yaml#
$schema: http://devicetree.org/meta-schemas/core.yaml#

title: Qualcomm PM6150L LCD Bias (LCDB) Regulator

maintainers:
  - hanoip-mainline Project <hanoip-mainline@example.org>

description:
  The PM6150L LCDB (LCD Bias) module generates the positive (LAB) and
  negative (IBB) supply rails for LCD display panels through an internal
  boost converter (BST).  It is exposed as a single SPMI peripheral at
  0xec00 that contains LDO (LAB), NCP (IBB) and BST blocks sharing one
  module-enable bit.  LAB and IBB are presented to the kernel as two
  logical regulators over the shared module.

properties:
  compatible:
    const: qcom,pm6150l-lcdb

  reg:
    maxItems: 1

  interrupts:
    items:
      - description: Short circuit interrupt

  interrupt-names:
    items:
      - const: sc-err

  lab:
    type: object
    $ref: regulator.yaml#
    unevaluatedProperties: false

    required:
      - regulator-name

  ibb:
    type: object
    $ref: regulator.yaml#
    unevaluatedProperties: false

    required:
      - regulator-name

required:
  - compatible
  - reg
  - lab
  - ibb

additionalProperties: false

examples:
  - |
    pm6150l_lcdb: regulator@ec00 {
        compatible = "qcom,pm6150l-lcdb";
        reg = <0xec00>;
        interrupts = <0x5 0xec 0x1 IRQ_TYPE_EDGE_RISING>;
        interrupt-names = "sc-err";

        lab {
            regulator-name = "lcdb_lab";
            regulator-min-microvolt = <5500000>;
            regulator-max-microvolt = <5500000>;
        };

        ibb {
            regulator-name = "lcdb_ibb";
            regulator-min-microvolt = <5500000>;
            regulator-max-microvolt = <5500000>;
        };
    };
```
