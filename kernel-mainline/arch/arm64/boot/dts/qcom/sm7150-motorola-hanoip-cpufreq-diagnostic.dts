// SPDX-License-Identifier: BSD-3-Clause
#include "sm7150-motorola-hanoip-touch-diagnostic.dts"

/* One-variable RAM test: CPUfreq on; idle, CPU count and display unchanged. */
&{/chosen} {
	bootargs = "earlycon=msm_geni_serial,0xa88000 console=ttyMSM0,115200n8 console=ttyGS0 console=ramoops console=tty1 loglevel=8 ignore_loglevel panic_on_oops=1 panic=5 pause_on_oops=5 pstore.backend=ramoops clk_ignore_unused consoleblank=0 vt.global_cursor_default=0 maxcpus=6 cpuidle.off=1 idle=poll";
};
